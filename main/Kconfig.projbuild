## main/Kconfig.projbuild
```kconfig
menu "ESP32 CSI Collection Tool Config"

    config SSID
        string "SSID"
        default "DESKTOP-8H"

    config PASSWORD
        string "PASSWORD"
        default "0f)8A374"

endmenu
```
